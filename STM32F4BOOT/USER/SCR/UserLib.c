//===============================================================================================
/************************************************************************************************
 *                                                                                                     
 *            文件名称:              
 *
 *                摘要: 
 *
 *            创建时间: 2008-10-10  
 *
 *            修改时间: 2008-10-10
 *            修改原因:
 *
 *            
 *
 *                作者: 杨卫华
 *
 *************************************************************************************************/
//===============================================================================================
#include "stm32f4xx.h"
#include "mystd.h"
#include "m_config.h"
#include "UserLib.h"

uint8_t Key2[4]={0xE2,0x60,0xAB,0xC3};

//================================================================================================
uint8_t INTState;

#ifdef __MY_DEBUG
int    AvoidNoUseWarning;
#endif

volatile uint32_t  TmCnt = 0;

//================================================================================================
/*************************************************************************************************
 *
 *         函数名称: 
 *
 *         函数功能: 微秒级延时
 *
 *         入口参数: 
 *
 *         出口参数: 无
 *
 *             说明:
 *
 *************************************************************************************************/
void  DelayUS(int32_t us)
{
    TIM_SetCounter(TIM4, 0x0);
    
    while(us > (TmCnt = TIM_GetCounter(TIM4)))
    {
        ;   
    }


}
void  DelayMS(int32_t ms)
{
		while(ms--)
		{
				DelayUS(1000);
		}


}
//================================================================================================
/*************************************************************************************************
 *
 *         函数名称: 
 *
 *         函数功能: 
 *
 *         入口参数: 
 *
 *         出口参数: 无
 *
 *             说明:
 *
 *************************************************************************************************/
void  Delay(uint32_t  n)
{
    while(n--)
    {
        ;
    
    
    }

}


//================================================================================================
/*************************************************************************************************
 *
 *         函数名称: 
 *
 *         函数功能: IO端口功能、方向设定
 *
 *         入口参数: 
 *
 *         出口参数: 无
 *
 *             说明:
 *
 *************************************************************************************************/
UINT16 BCD2UINT16(uint32_t bcd) 
{ 
    int i;
    UINT16 tmp;
    UINT16 k;
    
    k   = 1;
    tmp = 0;
    for (i = 0; i < 5; i++)
    {
        tmp += ((bcd >> (i * 4)) & 0xF) * k;
        k *= 10;        
        
    }
    
    return tmp;
} 


//================================================================================================
/*************************************************************************************************
 *
 *         函数名称: 
 *
 *         函数功能: IO端口功能、方向设定
 *
 *         入口参数: 
 *
 *         出口参数: 无
 *
 *             说明:
 *
 *************************************************************************************************/
uint8_t  DisINT(void)
{
    uint8_t  tmp = INTState;
    
    if (INTState == INT_OPEN)
    {
      /// ARMDisINT();
        INTState = INT_CLOSE;
    }
    
    return  tmp;  
    
}


//================================================================================================
/*************************************************************************************************
 *
 *         函数名称: 
 *
 *         函数功能: IO端口功能、方向设定
 *
 *         入口参数: 
 *
 *         出口参数: 无
 *
 *             说明:
 *
 *************************************************************************************************/
void  EnaINT(uint8_t old)
{
    if (old == INT_OPEN)  //原来是打开的
    {
        ////ARMEnaINT();
        INTState = INT_OPEN;
    }
    
}






//================================================================================================
/*************************************************************************************************
 *
 *         函数名称: 	MemoryCopy
 *
 *         函数功能:   内存拷贝
 *
 *         入口参数:   *s1，*s2，n:指定长度
 *
 *         出口参数: 无
 *
 *             说明:
 *
 *************************************************************************************************/
void MemoryCopy(void *s1, const void *s2, int n)
{
	int i;

	for (i = 0; i < n; i++)
	{
	    ((char *)(s1))[i] = ((const char *)(s2))[i];
    
    }
    
}


//================================================================================================
/*************************************************************************************************
 *
 *         函数名称:  MemoryHWordCopy
 *
 *         函数功能: 
 *
 *         入口参数: 	*s1，*s2，n:指定长度
 *
 *         出口参数: 无
 *
 *             说明:
 *
 *************************************************************************************************/
void MemoryHWordCopy(uint16_t *s1, const uint16_t *s2, int n)
{
	int i;

	for (i = 0; i < n; i++)
	{
	    *s1++ = *s2++;
    
    }
    
}


//================================================================================================
/*************************************************************************************************
 *
 *         函数名称:  MemoryCmp
 *
 *         函数功能:   内存比较
 *
 *         入口参数:   *s1，*s2，n:指定长度
 *
 *         出口参数: 无
 *
 *             说明:
 *
 *************************************************************************************************/
int MemoryCmp(void *s1, const void *s2, int n)
{
	int i;

	for (i = 0; i < n; i++)
	{
	    if (((unsigned char *)(s1))[i] != ((const unsigned  char *)(s2))[i])
	    {
	    
	        return 0;
	    }
    
    }
    
    return 1;
    
}

//================================================================================================
/*************************************************************************************************
 *
 *         函数名称: 
 *
 *         函数功能: 
 *
 *         入口参数: 
 *
 *         出口参数: 无
 *
 *             说明:
 *
 *************************************************************************************************/
void _memcpy(void *s1, const void *s2, int n)
{
	int i;

	for (i = 0; i < n; i++)
	{
	    ((char *)(s1))[i] = ((const char *)(s2))[i];
    
    }
    
}


//================================================================================================
/*************************************************************************************************
 *
 *         函数名称: 
 *
 *         函数功能: 
 *
 *         入口参数: 
 *
 *         出口参数: 无
 *
 *             说明:
 *
 *************************************************************************************************/
_BOOL _memcmp(void *s1, const void *s2, int n)
{
	int i;

	for (i = 0; i < n; i++)
	{
	    if (((char *)(s1))[i] != ((const char *)(s2))[i])
	    {
	    
	        return FALSE;
	    }
    
    }
    
    return TRUE;
    
}


//================================================================================================
/*************************************************************************************************
 *
 *         函数名称: 
 *
 *         函数功能: 
 *
 *         入口参数: 
 *
 *         出口参数: 无
 *
 *             说明:
 *
 *************************************************************************************************/
void __memset(void *s, const char ch, int n)
{
	int i;

	for (i = 0; i < n; i++)
	{
	    ((char *)(s))[i] = ch;
	
	}
	
}


//================================================================================================
/*************************************************************************************************
 *
 *         函数名称: 	 MemorySet
 *
 *         函数功能: 	 MemorySet
 *
 *         入口参数: 	 *s：指定存储地址；ch：指定写入字符串；n：指定长度
 *
 *         出口参数: 无
 *
 *             说明:
 *
 *************************************************************************************************/
void MemorySet(void *s, const char ch, int n)
{
	int i;

	for (i = 0; i < n; i++)
	{
	    ((char *)(s))[i] = ch;
	
	}
	
}



//======================================================================================================
/*******************************************************************************************************
 *
 *         函数名称: 
 *
 *         函数功能: 
 *
 *         入口参数: 
 *
 *         出口参数: 无
 *
 *             说明:
 *
 *******************************************************************************************************/
void  Trace1(char *fmt, ...)
{
    ///INT8U  err;


//     va_list ap;
//     char string[256];    
//     
//     
//     va_start(ap, fmt);
//     vsprintf(string, fmt, ap);
//     UsartPrintf(DEBUG_UART_CHNNL, string);
//     va_end(ap);
//     



}



#if __TRACE_EN == 1
//================================================================================================
/*************************************************************************************************
 *
 *         函数名称: 
 *
 *         函数功能: 
 *
 *         入口参数: 
 *
 *         出口参数: 无
 *
 *             说明:
 *
 *************************************************************************************************/
void  Trace(char *fmt, ...)
{
	
//    extern void UARTPrintf(const char *fmt,...);
//
// 
//	va_list ap;
//    char string[256];    
//    
//    
//    
//    va_start(ap, fmt);
//    vsprintf(string, fmt, ap);
//    UARTPrintf(CONSOLE_UART, string);
//    va_end(ap);
//    
}

#endif



#ifdef  USE_FULL_ASSERT

/**
  * @brief  Reports the name of the source file and the source line number
  *         where the assert_param error has occurred.
  * @param  file: pointer to the source file name
  * @param  line: assert_param error line source number
  * @retval None
  */
void assert_failed(uint8_t* file, uint32_t line)
{
  /* User can add his own implementation to report the file name and line number,
     ex: printf("Wrong parameters value: file %s on line %d\r\n", file, line) */

  while (1)
  {}
}
#endif


