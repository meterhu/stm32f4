//===============================================================================================
/************************************************************************************************
*                                                                                                     
*            文件名称:              
*
*                摘要: ADS123X驱动程序, 
*               
*                    引脚名称	对应IO管脚	  开入/开出
×                    ----------------------------------
*                      clk	      PB15	        开出
*                      dout 	  PD8	        开入
*                      rst	      PB14	        开出
*                      A0 	      PB12	        开出
*                      A1	      PB13	        开出
*
*            创建时间: 2009-06-30  
*
*            修改时间: 
*            修改原因:
*
*            
*
*                作者: 杨卫华
*
*************************************************************************************************/
//===============================================================================================
#include "stm32f4xx.h"
#include "mystd.h"
#include "m_config.h"
#include "InitHW.h"
#include "UART.h"
#include "UserLib.h"
#include "ADS123x.h"
#include "Filter.h"

//SPEED = 1  24个脉冲至少为12.44ms
//SPEED = 0  24个脉冲至少为99.94ms
#define  ADS123X_DLY()         Delay(9000)//DelayUS(500)




/*************************************************************************************************
*
*         函数名称: 
*
*         函数功能: 初始化AD相关GPIO管脚
*
*         入口参数: 
*
*         出口参数: 无
*
*             说明:
*
*************************************************************************************************/
void InitADS123xPin(void)
{
    GPIO_InitTypeDef GPIO_InitStructure;
    
    //引脚名称	对应IO管脚	  开入/开出
    //----------------------------------
    //clk	      PB15	        开出
    //dout 	    PB13          开入
    //rst	      PB12	        开出
    //A0 	      PB14	        开出
    //A1	      PB11	        开出
    //rst,clk,A0,A1
    GPIO_InitStructure.GPIO_Pin   = GPIO_Pin_11|GPIO_Pin_12|GPIO_Pin_14|GPIO_Pin_15;
    GPIO_InitStructure.GPIO_Speed = GPIO_Speed_50MHz;
    GPIO_InitStructure.GPIO_Mode  = GPIO_Mode_OUT;
    GPIO_Init(GPIOB, &GPIO_InitStructure);
    
    //DOUT
    GPIO_InitStructure.GPIO_Pin   = GPIO_Pin_13;
    GPIO_InitStructure.GPIO_Speed = GPIO_Speed_50MHz;
    GPIO_InitStructure.GPIO_Mode  = GPIO_Mode_IN;
    GPIO_Init(GPIOB, &GPIO_InitStructure);
    
}

//================================================================================================
/*************************************************************************************************
*
*         函数名称: 
*
*         函数功能: 
*
*         入口参数: 
*
*         出口参数: 无
*
*             说明:
*
*************************************************************************************************/
void TestADS123xIO(void)
{	
    
    InitADS123xPin();
    
    while(1)
    {
        ADS123X_CLK_H(); 
        ADS123X_CLK_L();   
        
        ADS123X_RST_H();
        ADS123X_RST_L();
        
        
        ADS123X_A0_H();
        ADS123X_A0_L();
        
        ADS123X_A1_H();
        ADS123X_A1_L();
 	}

}


//================================================================================================
/*************************************************************************************************
*
*         函数名称: 
*
*         函数功能: 
*
*         入口参数: 
*
*         出口参数: 无
*
*             说明:
*
*************************************************************************************************/
void InitADS123x(void)
{	
	InitADS123xPin();

	ADS123X_CLK_L();

	ADS123X_RST_L();
	Delay(8000000);   //最小至少保持26us
	ADS123X_RST_H();
	
	InitFILTER();
	
	//TestADS123xIO();
	
	ReadADS123x_Pri(4, 0x01); //先校准
	ReadADS123x_Pri(4, 0x00); //第一次读滤去
	
	
}


//================================================================================================
/*************************************************************************************************
*
*         函数名称: 
*
*         函数功能: 
*
*         入口参数: 
*
*         出口参数: 无
*
*             说明:
*
*************************************************************************************************/
void ADS123xSelChnnl(u8 chnnl)
{	
    switch(chnnl)
    {
        case 0:
        {
            ADS123X_A0_L();
            ADS123X_A1_L();
            break;
        
        }
        case 1:
        {
            ADS123X_A0_H();
            ADS123X_A1_L();
            break;
        }
        case 2:
        {
            ADS123X_A0_L();
            ADS123X_A1_H();
            break;
        }
        case 3:
        {
            ADS123X_A0_H();
            ADS123X_A1_H();
            break;
        }    
    
    }
	
	
}


//================================================================================================
/*************************************************************************************************
*
*         函数名称: 
*
*         函数功能: 
*
*         入口参数: chnnl:通道号
*                   calibr:0x01--校正; 0x00--不校正
*
*         出口参数: 无
*
*             说明: 0x01:校正,0x00:不校正
*
*************************************************************************************************/
s32 ReadADS123x_Pri(u8 chnnl, u8 calibr)  
{
	u8  i;
	s32  rt_v;
	
	rt_v = 0;
    
    ADS123xSelChnnl(chnnl);	

	while(ADS123X_DO()) //下降沿表示有效数据到来
	{
	    ;	 
	}	
	
	for (i =0; i < 24; i++) //循环读取数据
	{   
		ADS123X_CLK_H();  
		ADS123X_DLY();  
		
		rt_v =(rt_v << 0x01) | ADS123X_DO();
		ADS123X_CLK_L();  
	}
	
	ADS123X_CLK_H(); 
	ADS123X_DLY();  
	ADS123X_DLY();  
	ADS123X_CLK_L();  
	
	if (calibr)
	{
		ADS123X_CLK_H(); 
		
		ADS123X_DLY();
		ADS123X_DLY();  
		
		ADS123X_CLK_L();	
	}
	

	return rt_v;
	//return Filter(chnnl,rt_v);
	
}


//================================================================================================
/*************************************************************************************************
*
*         函数名称: 
*
*         函数功能: 读取AD稳定原始值
*
*         入口参数: chnnl:通道号
*                   calibr:0x01--校正; 0x00--不校正
*
*         出口参数: 无
*
*             说明: 0x01:校正,0x00:不校正
*
*************************************************************************************************/
s32 ReadADS123x(u8 chnnl) 
{
	s32 ad_v_buff[5];
    s32 tmp_ad_v;
    s32 ad_v;
        
    uint8_t   i,k;
    
    //连续读取5次AD值
    for(i = 0; i < 5; i++)
    {
         ad_v_buff[i] = ReadADS123x_Pri(chnnl,0);
        
    }
    
    //降序排列
    for(i = 0; i < 5; i++)
    {
         for(k = i + 1; k < 6; k++)
         {
              if(ad_v_buff[i] < ad_v_buff[k])
              {
                  tmp_ad_v = ad_v_buff[i];
                  ad_v_buff[i] = ad_v_buff[k];
                  ad_v_buff[k] = tmp_ad_v;
              }
         }
         
    }
    
    //去掉最大值和最小值，目的为了去掉毛刺
    ad_v = (ad_v_buff[1] + ad_v_buff[2] +ad_v_buff[3]) / 3;
    
    return ad_v;

}




