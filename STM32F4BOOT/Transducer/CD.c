//===============================================================================================
/************************************************************************************************
 *                                                                                                     
 *            文件名称:              
 *
 *                摘要: 
 *
 *            创建时间: 2012-05-20  
 *
 *            修改时间: 2012-05-20
 *            修改原因:
 *
 *                     
 *
 *                作者: 杨卫华
 *
 *************************************************************************************************/
 //===============================================================================================
#include "stm32f4xx.h" 
#include "stm32f4_std_libs.h"
#include "mystd.h"  
#include "m_config.h"
#include "UserLib.h"
#include "UART.h"
#include "Transdu.h"


//
//transducer.h  


//================================================================================================
/*************************************************************************************************
 *
 *         函数名称: 
 *
 *         函数功能: 
 *
 *         入口参数: 
 *
 *         出口参数: 无
 *
 *             说明:
 *
 *************************************************************************************************/
void CDRun(UINT16 rev_fwd, UINT16 rev_num)
{

    UINT8    i;
    UINT8   buff[20];
    UINT16  tmp_crc;
  
  //  Wait(60000); 
  //  Wait(60000);
//	Wait(60000);
//	Wait(60000);  
//	Wait(60000);    
	
	Wait(500000);   //2008-08-29
	
    //写入频率
	buff[0] = 0x01;
	buff[1] = 0x10;  //写入单笔数据
	
	buff[2] = 0x00;  //地址
	buff[3] = 0x00;
	
	buff[4] = 0x00;  //寄存器数量
    buff[5] = 0x02;
    
    buff[6] = 0x04;  //资料字节数量
    
    
    buff[7] = 0;
       
    if (rev_fwd == FWD_RUN)
    {   
        buff[8] = 0x01;
    }
    else if (rev_fwd == REV_RUN)
    {
        buff[8] = 0x02;
    
    }
	 
	//最高转速4000  4000=133.3    (rev_num / 4000) * x =  rev_num; x = 20 //2008-08-29  //原20 
	rev_num *= 10;
	rev_num /= 3;
	   
	//rev_num =  (rev_num * 75) / 10;
	//RevNum * ;
	         
	buff[9] = rev_num >> 8;
	buff[10] = rev_num & 0xFF;
	    
	tmp_crc = CRCCheck(buff, 11);
	    
	buff[11] = tmp_crc & 0xFF;   //低位在先
	buff[12] = tmp_crc >> 8;
	       
	for (i = 0; i < 13; i++)
	{
	    TRANS_COM_SEND_BYTE(buff[i]);
	    Wait(10);
	    
	}   
	     
	

          
}



//================================================================================================
/*************************************************************************************************
 *
 *         函数名称: 
 *
 *         函数功能: 
 *
 *         入口参数: 
 *
 *         出口参数: 无
 *
 *             说明:
 *
 *************************************************************************************************/
void CDStop(UINT16 rev_fwd)
{
    UINT8   i;
    UINT8   buff[20];
    UINT16  tmp_crc;
    
    Wait(500000);  //2008-08-29 
    
    buff[0] = 0x01;
	buff[1] = 0x10;  //写入单笔数据
	
    buff[2] = 0x00;  //地址
    buff[3] = 0x00; 
    
    buff[4] = 0x00;  //寄存器数量
    buff[5] = 0x01;
    
    buff[6] = 0x02;  //资料字节数量
    
    
    buff[7] = 0x00;
    if (rev_fwd == FWD_STOP)
    {   
        buff[8] = 0x03;
    }
    else if (rev_fwd == REV_STOP)
    {
        buff[8] = 0x03;
    
    }
    
    tmp_crc = CRCCheck(buff, 9);
    
    buff[9] = tmp_crc & 0xFF;   //低位在先
    buff[10] = tmp_crc >> 8;
    
    
    for (i = 0; i < 11; i++)
    {
        TRANS_COM_SEND_BYTE(buff[i]);
        Wait(10);
    
    }    
   
  
} 

