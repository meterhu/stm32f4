//===============================================================================================
/************************************************************************************************
 *                                                                                                     
 *            文件名称:              
 *
 *                摘要: 
 *
 *            创建时间: 2012-05-20  
 *
 *            修改时间: 2012-05-20
 *            修改原因:
 *
 *                     
 *
 *                作者: 杨卫华
 *
 *************************************************************************************************/
//===============================================================================================
#include "stm32f4xx.h" 
#include "stm32f4_std_libs.h"
#include "mystd.h"  
#include "m_config.h"
#include "UserLib.h"
#include "UART.h"
#include "Transdu.h"



void LGPutCmd(UINT16 Cmd, UINT16 Para);

//================================================================================================
/*************************************************************************************************
 *
 *         函数名称: 
 *
 *         函数功能: 
 *
 *         入口参数: 
 *
 *         出口参数: 无
 *
 *             说明:
 *
 *************************************************************************************************/
void LGPutCmd(UINT16 cmd, UINT16 para)
{

    UINT8 check_sum;
    UINT8 buff[15];  
    INT8  tmp;
    INT8  i;
     
    buff[0] = '0';  ///addr
    buff[1] = '1';  
    
    buff[2] = 'W'; //CMD = 'W'
    
    buff[3] = '0'; //func addr
    buff[4] = '0';
    buff[5] = '0';
    buff[6] = cmd;   
    
    buff[7] = '1';  //the number of address to write  
    
    for (i = 3; i >= 0; i--)
    {
        tmp = (para >> (i * 4 )) & 0x0F;
        if (tmp >= 0 && tmp <= 9)
        {
            tmp += '0';
        } 
        else
        {
            tmp = (tmp - 0x0a) + 'A';
        }      
       
        buff[11 - i] = tmp;  
    }
    
    check_sum = 0;
    TRANS_COM_SEND_BYTE(0x05);  //head,first byte
    for (i = 0; i < 12; i++)
    {
        TRANS_COM_SEND_BYTE(buff[i]);
        check_sum += buff[i];
        Wait(300);
    }  
    
    //校验和
    tmp =  (check_sum >> 4) & 0x0F;
    if (tmp >= 0 && tmp <= 9)
    {
        tmp += '0';
    }
    else
    {
        tmp = (tmp - 0x0a) + 'A';
    }
    TRANS_COM_SEND_BYTE(tmp);
    Wait(300); 
    
    tmp = check_sum & 0x0F;
    if (tmp >= 0 && tmp <= 9)
    {
        tmp += '0';
    }
    else 
    {
        tmp = (tmp - 0x0a) + 'A';
    } 
    TRANS_COM_SEND_BYTE(tmp);  
    Wait(300);
    TRANS_COM_SEND_BYTE(0x04); //EOT

}
 

//================================================================================================
/*************************************************************************************************
 *
 *         函数名称: 
 *
 *         函数功能: 
 *
 *         入口参数: 
 *
 *         出口参数: 无
 *
 *             说明:
 *
 *************************************************************************************************/
void OpenLGWP(UINT32 param)
{
     Wait(500000);
    
    //LGPutCmd(0x34, 0x1); 
    
   // LGPutCmd(0x32, 0x1); 
    LGPutCmd(0x34, 0x1); 


}
//================================================================================================
/*************************************************************************************************
 *
 *         函数名称: 
 *
 *         函数功能: 
 *
 *         入口参数: 
 *
 *         出口参数: 无
 *
 *             说明:
 *
 *************************************************************************************************/
void LGRun(UINT16 rev_fwd, UINT16 rev_num)
{
   
    
     //Wait(500000);
    
    //LGPutCmd(0x34, 0x1); 
    
   // LGPutCmd(0x32, 0x1); 
    //LGPutCmd(0x34, 0x1); 
    
    
    Wait(500000);  
    
    rev_num = (rev_num * 10) / 3;
    LGPutCmd(0x35, rev_num); 
    
    Wait(800000);
   

    if (rev_fwd == FWD_RUN)
    { 
        LGPutCmd(0x36, 0x02);
    }   
    else
    {
        LGPutCmd(0x36, 0x04);
    }
    
} 


 


//================================================================================================
/*************************************************************************************************
 *
 *         函数名称: 
 *
 *         函数功能: 
 *
 *         入口参数: 
 *
 *         出口参数: 无
 *
 *             说明:
 *
 *************************************************************************************************/
void LGStop(UINT16 rev_fwd)
{
    LGPutCmd(0x36, 0x01);
    
}
  
