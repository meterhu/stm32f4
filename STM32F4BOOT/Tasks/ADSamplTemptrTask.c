//======================================================================================================
/******************************************************************************************************
 *                                                                                                     
 *            文件名称:              
 *
 *                摘要: 
 *
 *            创建时间: 2012-05-xx  
 *
 *            修改时间: 2012-05-xx
 *            修改原因:
 *
 *            
 *
 *                作者: 杨卫华
 *
 *******************************************************************************************************/
//======================================================================================================
#include "stm32f4xx.h" 
#include "ucos_ii.h"
#include "mystd.h"  
#include "m_config.h"
#include "SysAppConfig.h"
#include "UserLib.h"
#include "FramePack.h"
#include "main.h"
#include "tasks.h"
#include "INOut.h"
#include "DS18B20.h"
#include "AD.h"
#include "OS_Trace.h"

//================================================================================================
extern SYS_APP_CFG  SysAppCfg;


//======================================================================================================
/*******************************************************************************************************
 *
 *         函数名称: 
 *
 *         函数功能:  温度控制任务
 *
 *         入口参数: 
 *
 *         出口参数: 无
 *
 *             说明:
 *
 *******************************************************************************************************/
void  TmptrCtrlTask(void *p_arg)
{
    AppData.set_tmptr = (int16_t)((uint32_t)p_arg);
    
    while(TRUE_P)
    {
        if (AppData.set_tmptr >= (AppData.cur_tmptr + 2)) //2度
        {
            OUT_WARM_UP();
            //OUT_H_WARM_UP();

        }
        else if (AppData.cur_tmptr >= (AppData.set_tmptr + 2)) //2度
        {
             //风冷
             //OUT_COOL_DW();
             OUT_COOL_DW_FAN();
                                                   
        }
        
        OS_Trace("TmptrCtrlTask Run\n");
        
        OSTimeDlyHMSM(0, 0, 0, 800);

    }

}


//======================================================================================================
/*******************************************************************************************************
 *
 *         函数名称: 
 *
 *         函数功能:  AD采样值获取
 *
 *         入口参数: 
 *
 *         出口参数: 无
 *
 *             说明:
 *
 *******************************************************************************************************/

void  ADSamplTask(void *p_arg)
{
    int16_t buff[4];
    uint8_t i;
     
    while(TRUE_P)
    {
       __memset(buff, 0, 8);
       for (i = 0; i < 4; i++)
       {
           if (SysAppCfg.ad_chnnl_use[i])
           {
               buff[i] = ADSampl(i);
               //OS_Trace("AD Value = %d\n",buff[i]);
           }

       }
       
       SendFrame(FRM_CMD_AD_V,  (uint8_t *)buff, 8);   //8即8个字节

       OSTimeDlyHMSM(0, 0, 0, 300);
    
    }

}


//======================================================================================================
/*******************************************************************************************************
 *
 *         函数名称: 
 *
 *         函数功能: 温度采样值数据获取
 *
 *         入口参数: 
 *
 *         出口参数: 无
 *
 *             说明:
 *
 *******************************************************************************************************/
void  TmptrSamplTask(void *p_arg)
{

    INT16S       tmptr[2] = {0};
    INT16S       rt_v = 1;     
    //uint32_t     debug_v = 0;
    

    OSTimeDlyHMSM(0, 0, 0, 100);
    while(TRUE_P) 
    {
        rt_v = GemTemptr(&tmptr[0]);
        if (rt_v > 0)
        { 
            
            //SendFrame(FRM_CMD_TMPTR_V, (uint8_t *)&tmptr, 4);   //4即4个字节
            //debug_v++;
            SendFrame(FRM_CMD_TMPTR_V, (uint8_t *)&tmptr[0], 4);   //4即4个字节
            AppData.cur_tmptr = tmptr[0];
            OS_Trace("Tmptr Value = %d\n",tmptr[0]);
    
        }
        else if (rt_v == TMPTR_INIT_TMOUT)
        {
           ;///TRACE("init timeout\r\n");
        }
        else if (rt_v == TMPTR_INIT_OVER)
        {
           ; ///TRACE("init over\r\n");
        }
        
        OSTimeDlyHMSM(0, 0, 0, 200);

    } 


}






